## meta-balena-common/conf/layer.conf
```bitbake
BBPATH .= ":${LAYERDIR}"

BBFILES += "${LAYERDIR}/recipes-*/*/*.bb \
            ${LAYERDIR}/recipes-*/*/*.bbappend"

BBFILE_COLLECTIONS += "balena-common"
BBFILE_PATTERN_balena-common := "^${LAYERDIR}/"
BBFILE_PRIORITY_balena-common = "1337"

# FIXME: Temporarily set back to dunfell, as it seems to be the version
#        currently supported for the Pi family.
LAYERSERIES_COMPAT_balena-common = "dunfell"

BALENA_DEPRECATED_YOCTO_LAYER ?= "0"

BALENA_COREBASE := '${@os.path.normpath("${LAYERDIR}/")}'

IMAGE_ROOTFS_SIZE ?= "0"
```
